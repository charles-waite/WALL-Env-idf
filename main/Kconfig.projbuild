## main/Kconfig.projbuild
```kconfig
menu "Example Configuration"

    config SHTC3_I2C_SDA_PIN
        int "I2C SDA Pin"
        default 22
        help
            GPIO number for I2C master data

    config SHTC3_I2C_SCL_PIN
        int "I2C SCL Pin"
        default 23
        help
            GPIO number for I2C master clock

    config I2C_MASTER_FREQ_HZ
        int "I2C Master Frequency (Hz)"
        default 400000
        help
            I2C bus clock frequency

    config BME68X_I2C_ADDR
        hex "BME68x I2C Address"
        default 0x77
        help
            I2C address for the BME68x sensor (0x76 or 0x77)

    config WALL_ENV_OLED_ENABLE
        bool "Enable SSD1306 OLED"
        default y
        help
            Enable the SSD1306 OLED task (I2C) for splash/status output.

    config WALL_ENV_OLED_I2C_ADDR
        hex "OLED I2C Address"
        depends on WALL_ENV_OLED_ENABLE
        default 0x3C
        help
            I2C address for the SSD1306 OLED (commonly 0x3C or 0x3D)

    config WALL_ENV_OLED_WIDTH
        int "OLED width (px)"
        depends on WALL_ENV_OLED_ENABLE
        default 128
        help
            SSD1306 panel width in pixels (only 128 supported currently).

    config WALL_ENV_OLED_HEIGHT
        int "OLED height (px)"
        depends on WALL_ENV_OLED_ENABLE
        default 64
        help
            SSD1306 panel height in pixels (only 64 supported currently).

    config WALL_ENV_OLED_SPLASH_MS
        int "OLED splash duration (ms)"
        depends on WALL_ENV_OLED_ENABLE
        default 5000
        help
            How long to display the splash screen on boot, in milliseconds.

    config PIR_DATA_PIN
        int "PIR Data Pin"
        default 7
        help
            Default PIR Data Pin

endmenu
```

## sdkconfig.defaults
```kconfig
CONFIG_ESPTOOLPY_FLASHSIZE_4MB=y

#enable BT
CONFIG_BT_ENABLED=y
CONFIG_BT_NIMBLE_ENABLED=y

#disable BT connection reattempt
CONFIG_BT_NIMBLE_ENABLE_CONN_REATTEMPT=n

#enable lwip ipv6 autoconfig
CONFIG_LWIP_IPV6_AUTOCONFIG=y

# OpenThread (required for Matter-over-Thread + Thread Network Commissioning)
CONFIG_OPENTHREAD_ENABLED=y
CONFIG_OPENTHREAD_SRP_CLIENT=y
CONFIG_OPENTHREAD_DNS_CLIENT=y
CONFIG_OPENTHREAD_LOG_LEVEL_DYNAMIC=n
CONFIG_OPENTHREAD_LOG_LEVEL_NOTE=y
CONFIG_OPENTHREAD_CLI=n

# Console transport: USB Serial/JTAG primary (matches /dev/cu.usbmodem* workflow)
CONFIG_ESP_CONSOLE_UART_DEFAULT=n
CONFIG_ESP_CONSOLE_USB_SERIAL_JTAG=y
CONFIG_ESP_CONSOLE_SECONDARY_NONE=y

# Use a custom partition table
CONFIG_PARTITION_TABLE_CUSTOM=y
CONFIG_PARTITION_TABLE_FILENAME="partitions.csv"
CONFIG_PARTITION_TABLE_OFFSET=0xC000

#enable lwIP route hooks
CONFIG_LWIP_HOOK_IP6_ROUTE_DEFAULT=y
CONFIG_LWIP_HOOK_ND6_GET_GW_DEFAULT=y

# Button
CONFIG_BUTTON_PERIOD_TIME_MS=20
CONFIG_BUTTON_LONG_PRESS_TIME_MS=5000

# disable softap by default
CONFIG_ESP_WIFI_SOFTAP_SUPPORT=n

# Thread-only: disable Wi-Fi features (no STA/AP, no Wi-Fi commissioning/diagnostics).
# Note: on ESP32-C6 the low-level Wi-Fi component may still be built/linked by IDF defaults,
# but with the settings below it is not used by Matter.
CONFIG_ESP_WIFI_ENABLED=n
CONFIG_ENABLE_WIFI_STATION=n
CONFIG_WIFI_NETWORK_COMMISSIONING_DRIVER=n
CONFIG_THREAD_NETWORK_COMMISSIONING_DRIVER=y
CONFIG_SUPPORT_WIFI_NETWORK_DIAGNOSTICS_CLUSTER=n
CONFIG_SUPPORT_WIFI_NETWORK_MANAGEMENT_CLUSTER=n
CONFIG_SUPPORT_ETHERNET_NETWORK_DIAGNOSTICS_CLUSTER=n
CONFIG_ENABLE_WIFI_TELEMETRY=n

# Disable RainMaker's Wi‑Fi transport (we're Thread-only).
CONFIG_ESP_RMAKER_NETWORK_OVER_WIFI=n
CONFIG_ESP_RMAKER_NETWORK_OVER_THREAD=y

# Enable HKDF in mbedtls
CONFIG_MBEDTLS_HKDF_C=y

# Increase LwIP IPv6 address number to 6 (MAX_FABRIC + 1)
# unique local addresses for fabrics(MAX_FABRIC), a link local address(1)
CONFIG_LWIP_IPV6_NUM_ADDRESSES=6

# Use IDF mDNS (not CHIP minimal) to avoid commissioning/DNS-SD advertise issues.
CONFIG_USE_MINIMAL_MDNS=n

# Thread-only: use IDF mDNS on OpenThread netif only (avoid pulling in Wi‑Fi).
CONFIG_MDNS_PREDEF_NETIF_STA=n
CONFIG_MDNS_PREDEF_NETIF_AP=n
CONFIG_MDNS_PREDEF_NETIF_ETH=n
CONFIG_MDNS_MAX_INTERFACES=1

# No dynamic endpoints are created at runtime (ZAP-generated model is used),
# but keep a small non-zero value to avoid surprises if we temporarily add any.
CONFIG_ESP_MATTER_MAX_DYNAMIC_ENDPOINT_COUNT=6

# ESP32-DevKitC Settings
# Buttons

# Disable OTA (no OTA Requestor / single-app partition layout)
CONFIG_ENABLE_OTA_REQUESTOR=n
CONFIG_SUPPORT_OTA_SOFTWARE_UPDATE_PROVIDER_CLUSTER=n
CONFIG_SUPPORT_OTA_SOFTWARE_UPDATE_REQUESTOR_CLUSTER=n

# Prune optional Matter clusters we do not expose to reduce build/gen overhead.
CONFIG_SUPPORT_THREAD_BORDER_ROUTER_MANAGEMENT_CLUSTER=n
CONFIG_SUPPORT_THREAD_NETWORK_DIRECTORY_CLUSTER=n
CONFIG_SUPPORT_WEB_RTC_TRANSPORT_PROVIDER_CLUSTER=n
CONFIG_SUPPORT_WEB_RTC_TRANSPORT_REQUESTOR_CLUSTER=n

# Disable diagnostics/insights feature set for faster builds.
CONFIG_DIAG_ENABLE_METRICS=n
CONFIG_DIAG_ENABLE_HEAP_METRICS=n
CONFIG_DIAG_ENABLE_WIFI_METRICS=n
CONFIG_DIAG_ENABLE_VARIABLES=n
CONFIG_DIAG_ENABLE_NETWORK_VARIABLES=n
CONFIG_ESP_INSIGHTS_ENABLED=n

# Disable LVGL examples/demos (huge compile-time reduction).

# I2C bus
CONFIG_SHTC3_I2C_SDA_PIN=22
CONFIG_SHTC3_I2C_SCL_PIN=23
CONFIG_I2C_MASTER_FREQ_HZ=400000
CONFIG_BME68X_I2C_ADDR=0x77

# OLED (SH1106 I2C @ 0x3C)
CONFIG_WALL_ENV_OLED_ENABLE=y
CONFIG_WALL_ENV_OLED_I2C_ADDR=0x3C
CONFIG_WALL_ENV_OLED_COL_OFFSET=2
CONFIG_WALL_ENV_OLED_WIDTH=128
CONFIG_WALL_ENV_OLED_HEIGHT=64
CONFIG_WALL_ENV_OLED_SPLASH_MS=5000

# Device identity + versioning (derived from main/chip_project_config.h)
# Software version integer uses SemVer: major*10000 + minor*100 + patch.
CONFIG_CHIP_PROJECT_CONFIG="main/chip_project_config.h"
CONFIG_USE_TEST_SERIAL_NUMBER="001"
CONFIG_DEVICE_VENDOR_ID=0xFFF1
CONFIG_DEVICE_PRODUCT_ID=0x8000
CONFIG_DEVICE_SOFTWARE_VERSION_NUMBER=600
CONFIG_DEFAULT_DEVICE_HARDWARE_VERSION=1

# Allow Matter Time Sync to map to system wall clock (`settimeofday`).
CONFIG_ENABLE_SNTP_TIME_SYNC=y

# CHIP log verbosity: use ERROR to suppress routine INFO/PROGRESS chatter.
CONFIG_CHIP_LOG_DEFAULT_LEVEL_EQUALS_LOG_DEFAULT_LEVEL=n
CONFIG_CHIP_LOG_DEFAULT_LEVEL_ERROR=y
```
